/ {
    chosen {
        zmk,kscan = &kscan0;
    };

    kscan0: kscan {
        compatible = "zmk,kscan-gpio-direct";

        input-gpios =
            <&gpio0 2  (GPIO_PULL_UP | GPIO_ACTIVE_LOW)>,
            <&gpio0 29  (GPIO_PULL_UP | GPIO_ACTIVE_LOW)>,
            <&gpio0 31  (GPIO_PULL_UP | GPIO_ACTIVE_LOW)>;

        status = "okay";
    };
};
