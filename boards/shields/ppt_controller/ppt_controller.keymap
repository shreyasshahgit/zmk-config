#include <behaviors.dtsi>
#include <dt-bindings/zmk/keys.h>

/ {
    keymap {
        compatible = "zmk,keymap";

        default_layer {
            bindings = <
                &bt BT_CLR
                &kp A
                &kp B
            >;
        };
    };
};
