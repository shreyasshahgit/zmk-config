## boards/arm/holyiot_yj17095/Kconfig.board
```kconfig
config BOARD_HOLYIOT_YJ17095
    bool "Holyiot YJ-17095"
    select SOC_NRF52832_QFAA
```

## boards/shields/ppt_controller/Kconfig.defconfig
```kconfig
if SHIELD_PPT_CONTROLLER

config ZMK_KEYBOARD_NAME
    default "PPT CTLR"

endif
```
